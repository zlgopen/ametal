/*******************************************************************************
*                                 AMetal
*                       ----------------------------
*                       innovating embedded platform
*
* Copyright (c) 2001-2018 Guangzhou ZHIYUAN Electronics Co., Ltd.
* All rights reserved.
*
* Contact information:
* web site:    http://www.zlg.cn/
*******************************************************************************/

/**
 * \file
 * \brief 飞行时间传感器 TMF8801 驱动文件
 *
 * \internal
 * \par Modification history
 * - 1.00 20-02-28  YRZ, first implementation.
 * \endinternal
 */

#include "am_sensor_tmf8801.h"
#include "am_sensor.h"
#include "am_gpio.h"
#include "am_delay.h"
#include "am_vdebug.h"

/*******************************************************************************
 * 宏定义
 ******************************************************************************/
#define __TMF8801_REG_APPID                   (0x00)  /* 当前运行的APP ID     */
#define __TMF8801_REG_APPREV_MAJ0R            (0x01)  /* APP主版本            */
#define __TMF8801_REG_APPREQID                (0x02)  /* 选择APP运行          */
#define __TMF8801_REG_ENABLE                  (0xE0)  /* CPU复位、状态        */
#define __TMF8801_REG_INT_STATUS              (0xE1)  /* 中断状态寄存器       */
#define __TMF8801_REG_INT_ENAB                (0xE2)  /* 中断使能寄存器       */
#define __TMF8801_REG_ID                      (0xE3)  /* 芯片ID寄存器         */
#define __TMF8801_REG_REVID                   (0xE4)  /* 芯片版本ID           */

/*******************************************************************************
 * APP_ID = 0xC0，运行距离测量APP，寄存器说明
 ******************************************************************************/
#define __TMF8801_REG_CMD_DATA9               (0x06)  /* 命令数据9寄存器      */
#define __TMF8801_REG_CMD_DATA8               (0x07)  /* 命令数据8寄存器      */
#define __TMF8801_REG_CMD_DATA7               (0x08)  /* 命令数据7寄存器      */
#define __TMF8801_REG_CMD_DATA6               (0x09)  /* 命令数据6寄存器      */
#define __TMF8801_REG_CMD_DATA5               (0x0A)  /* 命令数据5寄存器      */
#define __TMF8801_REG_CMD_DATA4               (0x0B)  /* 命令数据4寄存器      */
#define __TMF8801_REG_CMD_DATA3               (0x0C)  /* 命令数据3寄存器      */
#define __TMF8801_REG_CMD_DATA2               (0x0D)  /* 命令数据2寄存器      */
#define __TMF8801_REG_CMD_DATA1               (0x0E)  /* 命令数据1寄存器      */
#define __TMF8801_REG_CMD_DATA0               (0x0F)  /* 命令数据0寄存器      */
#define __TMF8801_REG_COMMAND                 (0x10)  /* 命令寄存器           */
#define __TMF8801_REG_PREVIOUS                (0x11)  /* 上一个被执行的命令   */
#define __TMF8801_REG_APPREV_MINOR            (0x12)  /* APP次版本            */
#define __TMF8801_REG_APPREV_PATCH            (0x13)  /* APP补丁号            */
#define __TMF8801_REG_STATUS                  (0x1D)  /* 当前状态             */
#define __TMF8801_REG_REG_CONTENT             (0x1E)  /* 寄存器当前所属内容   */
#define __TMF8801_REG_TID                     (0x1F)  /* 传输ID               */
#define __TMF8801_REG_RESULT_NUMBER           (0x20)  /* 结果号码             */
#define __TMF8801_REG_RESULT_INFO             (0x21)  /* 结果信息             */
#define __TMF8801_REG_DISTANCE_PEAK_0         (0x22)  /* 距离峰值寄存器0      */
#define __TMF8801_REG_DISTANCE_PEAK_1         (0x23)  /* 距离峰值寄存器1      */
#define __TMF8801_REG_SYS_CLOCK_0             (0x24)  /* 系统时钟寄存器0      */
#define __TMF8801_REG_SYS_CLOCK_1             (0x25)  /* 系统时钟寄存器1      */
#define __TMF8801_REG_SYS_CLOCK_2             (0x26)  /* 系统时钟寄存器2      */
#define __TMF8801_REG_SYS_CLOCK_3             (0x27)  /* 系统时钟寄存器3      */
#define __TMF8801_REG_STATE_DATA_0            (0x28)  /* 状态数据寄存器0      */
#define __TMF8801_REG_STATE_DATA_1            (0x29)  /* 状态数据寄存器1      */
#define __TMF8801_REG_STATE_DATA_2            (0x2A)  /* 状态数据寄存器2      */
#define __TMF8801_REG_STATE_DATA_3            (0x2B)  /* 状态数据寄存器3      */
#define __TMF8801_REG_STATE_DATA_4            (0x2C)  /* 状态数据寄存器4      */
#define __TMF8801_REG_STATE_DATA_5            (0x2D)  /* 状态数据寄存器5      */
#define __TMF8801_REG_STATE_DATA_6            (0x2E)  /* 状态数据寄存器6      */
#define __TMF8801_REG_STATE_DATA_7            (0x2F)  /* 状态数据寄存器7      */
#define __TMF8801_REG_STATE_DATA_8_XTALK_MSB  (0x30)  /* 状态数据寄存器8高字节 */
#define __TMF8801_REG_STATE_DATA_9_XTALK_LSB  (0x31)  /* 状态数据寄存器9低字节 */
#define __TMF8801_REG_STATE_DATA_10_TJ        (0x32)  /* 状态数据寄存器10温度 */
#define __TMF8801_REG_REFERENCE_HITS_0        (0x33)  /* 命中参考寄存器0      */
#define __TMF8801_REG_REFERENCE_HITS_1        (0x34)  /* 命中参考寄存器1      */
#define __TMF8801_REG_REFERENCE_HITS_2        (0x35)  /* 命中参考寄存器2      */
#define __TMF8801_REG_REFERENCE_HITS_3        (0x36)  /* 命中参考寄存器3      */
#define __TMF8801_REG_OBJECT_HITS_0           (0x37)  /* 命中物体寄存器0      */
#define __TMF8801_REG_OBJECT_HITS_1           (0x38)  /* 命中物体寄存器1      */
#define __TMF8801_REG_OBJECT_HITS_2           (0x39)  /* 命中物体寄存器2      */
#define __TMF8801_REG_OBJECT_HITS_3           (0x3A)  /* 命中物体寄存器3      */

/**< \brief 校准和算法状态数据交换，寄存器说明 */        
#define __TMF8801_REG_FACTORY_CALIB_0         (0x20)  /* 工厂校准数据寄存器0  */
#define __TMF8801_REG_FACTORY_CALIB_1         (0x21)  /* 工厂校准数据寄存器1  */
#define __TMF8801_REG_FACTORY_CALIB_2         (0x22)  /* 工厂校准数据寄存器2  */
#define __TMF8801_REG_FACTORY_CALIB_3         (0x23)  /* 工厂校准数据寄存器3  */
#define __TMF8801_REG_FACTORY_CALIB_4         (0x24)  /* 工厂校准数据寄存器4  */
#define __TMF8801_REG_FACTORY_CALIB_5         (0x25)  /* 工厂校准数据寄存器5  */
#define __TMF8801_REG_FACTORY_CALIB_6         (0x26)  /* 工厂校准数据寄存器6  */
#define __TMF8801_REG_FACTORY_CALIB_7         (0x27)  /* 工厂校准数据寄存器7  */
#define __TMF8801_REG_FACTORY_CALIB_8         (0x28)  /* 工厂校准数据寄存器8  */
#define __TMF8801_REG_FACTORY_CALIB_9         (0x29)  /* 工厂校准数据寄存器9  */
#define __TMF8801_REG_FACTORY_CALIB_10        (0x2A)  /* 工厂校准数据寄存器10 */
#define __TMF8801_REG_FACTORY_CALIB_11        (0x2B)  /* 工厂校准数据寄存器11 */
#define __TMF8801_REG_FACTORY_CALIB_12        (0x2C)  /* 工厂校准数据寄存器12 */
#define __TMF8801_REG_FACTORY_CALIB_13        (0x2D)  /* 工厂校准数据寄存器13 */
#define __TMF8801_REG_STATE_DATA_WR_0         (0x2E)  /* 状态数据读写寄存器0  */
#define __TMF8801_REG_STATE_DATA_WR_1         (0x2F)  /* 状态数据读写寄存器1  */
#define __TMF8801_REG_STATE_DATA_WR_2         (0x30)  /* 状态数据读写寄存器2  */
#define __TMF8801_REG_STATE_DATA_WR_3         (0x31)  /* 状态数据读写寄存器3  */
#define __TMF8801_REG_STATE_DATA_WR_4         (0x32)  /* 状态数据读写寄存器4  */
#define __TMF8801_REG_STATE_DATA_WR_5         (0x33)  /* 状态数据读写寄存器5  */
#define __TMF8801_REG_STATE_DATA_WR_6         (0x34)  /* 状态数据读写寄存器6  */
#define __TMF8801_REG_STATE_DATA_WR_7         (0x35)  /* 状态数据读写寄存器7  */
#define __TMF8801_REG_STATE_DATA_WR_8         (0x36)  /* 状态数据读写寄存器8  */
#define __TMF8801_REG_STATE_DATA_WR_9         (0x37)  /* 状态数据读写寄存器9  */
#define __TMF8801_REG_STATE_DATA_WR_10        (0x38)  /* 状态数据读写寄存器10 */
#define __TMF8801_REG_HISTOGRAM_START         (0x20)  /* 直方图起始寄存器     */
#define __TMF8801_REG_HISTOGRAM_END           (0x9F)  /* 直方图结束寄存器     */
#define __TMF8801_REG_SERIAL_NUMBER_0         (0x28)  /* 序列号寄存器0        */
#define __TMF8801_REG_SERIAL_NUMBER_1         (0x29)  /* 序列号寄存器1        */
#define __TMF8801_REG_IDENTIFICATION_NUMBER_0 (0x2A)  /* ID号寄存器0          */
#define __TMF8801_REG_IDENTIFICATION_NUMBER_1 (0x2B)  /* ID号寄存器0          */

/*******************************************************************************
 * APP_ID = 0x80，运行BootLoader APP，寄存器说明
 ******************************************************************************/
#define __TMF8801_REG_BL_CMD_STAT             (0x08)  /* BootLoader命令状态寄存器 */
#define __TMF8801_REG_BL_SIZE                 (0x09)  /* BootLoader大小寄存器 */
#define __TMF8801_REG_BL_DATA                 (0x0A)  /* BootLoader数据首地址 */
#define __TMF8801_REG_BL_DATA_LEN             (0x80)  /* BootLoader数据长度   */
#define __TMF8801_REG_BL_CSUM                 (0x8B)  /* BootLoader数据校验和 */

/*******************************************************************************
 * TOF命令
 ******************************************************************************/
/** \brief TMF8801软件复位 */
#define __TMF8801_SW_RST                      (0x1<<7)

/** \brief TMF8801 唤醒 */
#define __TMF8801_WKUP                        (0x1<<0)

/** \brief TMF8801 ID */
#define __TMF8801_ID                          (0x07)

/** \brief TMF8801 APP为BootLoader */
#define __TMF8801_BOOTLOADER                  (0x80)

/** \brief TMF8801 APP为测距 */
#define __TMF8801_MEASURE                     (0xC0)

/**< 不提供数据 */
#define __TMF8801_NO_DATA_PROVIDE             (0)

/**< 提供了工厂校准数据 */
#define __TMF8801_FACTORY_CALIBRATION_PROVIDE (1)

/**< 提供了算法校准数据 */
#define __TMF8801_ALGORITHM_STATE_PROVIDE     (2)

/**< GPIO设为输入 */
#define __TMF8801_GPIO0_INPUT                 (0x00)
#define __TMF8801_GPIO1_INPUT                 (0x00 << 4)

/**< 使能调试信息 */
#define __TMF8801_DEBUG                       (0)

/**< APP固件 */
const uint8_t __g_app_buf[] = {
0x6D, 0xC9, 0x41, 0x85, 0x3D, 0x15, 0xAA, 0x51, 0xF4, 0xD2, 0x9E, 0xA8, 0xA7, 0xAC, 0x77, 0xE9,
0xF9, 0xEC, 0x20, 0x24, 0x63, 0xB8, 0xF1, 0xA5, 0x0B, 0xA7, 0x65, 0xB4, 0x32, 0xB8, 0x18, 0xD7,
0x5C, 0xF4, 0x00, 0xD0, 0xDC, 0xFD, 0xD9, 0xD5, 0x98, 0xAF, 0x6F, 0x40, 0x96, 0x0A, 0xB2, 0xFA,
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0xBE, 0xF2, 0x7F, 0xDB, 0x0E, 0x99, 0x9F, 0x8C, 0x56, 0xD7, 0x6E, 0xD6, 0xCA, 0x55, 0x52, 0x66,
};

/** \brief 校准数据 */
uint8_t __g_cali_buf[14] = {
        0x81, 0x47, 0x00, 0xf5, 0x94, 0x3f, 0xc3, 
        0x07, 0x0b, 0x08, 0x32, 0x6c, 0x00, 0x04,};

/** \brief 状态数据 */
uint8_t __g_state_buf[11] = {
        0xB1, 0xD3, 0x04, 0x00, 0x37, 0x70,
        0x02, 0x00, 0x00, 0x00, 0x00};

/*******************************************************************************
 * 本地函数声明
 ******************************************************************************/
/** \brief 获取该传感器某一通道的类型 */
am_local am_err_t __pfn_type_get (void *p_drv, int id);

/** \brief 获取传感器通道采样数据 */
am_local am_err_t __pfn_data_get (void            *p_drv,
                                  const int       *p_ids,
                                  int              num,
                                  am_sensor_val_t *p_buf);

/** \brief 使能传感器通道 */
am_local am_err_t __pfn_enable (void            *p_drv,
                                const int       *p_ids,
                                int              num,
                                am_sensor_val_t *p_result);

/** \brief 禁能传感器通道 */
am_local am_err_t __pfn_disable (void            *p_drv,
                                 const int       *p_ids,
                                 int              num,
                                 am_sensor_val_t *p_result);

/** \brief 配置传感器通道属性 */
am_local am_err_t __pfn_attr_set (void                  *p_drv,
                                  int                    id,
                                  int                    attr,
                                  const am_sensor_val_t *p_val);

/** \brief 获取传感器通道属性 */
am_local am_err_t __pfn_attr_get (void            *p_drv,
                                  int              id,
                                  int              attr,
                                  am_sensor_val_t *p_val);

/** \brief 设置触发，一个通道仅能设置一个触发回调函数 */
am_local am_err_t __pfn_trigger_cfg (void                   *p_drv,
                                     int                     id,
                                     uint32_t                flags,
                                     am_sensor_trigger_cb_t  pfn_cb,
                                     void                   *p_arg);

/** \brief 打开触发 */
am_local am_err_t __pfn_trigger_on (void *p_drv, int id);

/** \brief 关闭触发 */
am_local am_err_t __pfn_trigger_off (void *p_drv, int id);

/** \brief 传感器标准服务 */
am_local am_const struct am_sensor_drv_funcs __g_sensor_tmf8801_funcs = {
        __pfn_type_get,
        __pfn_data_get,
        __pfn_enable,
        __pfn_disable,
        __pfn_attr_set,
        __pfn_attr_get,
        __pfn_trigger_cfg,
        __pfn_trigger_on,
        __pfn_trigger_off
};

/*******************************************************************************
  Local functions
*******************************************************************************/
/**
 * \brief tmf8801 写数据
 */
am_local am_err_t __tmf8801_write (am_sensor_tmf8801_dev_t *p_this,
                                   uint32_t                 subaddr,
                                   uint8_t                 *p_buf,
                                   uint32_t                 nbytes)
{
    return am_i2c_write(&p_this->i2c_dev,
                        subaddr,
                        p_buf,
                        nbytes);
}

/**
 * \brief tmf8801 读数据
 */
am_local am_err_t __tmf8801_read (am_sensor_tmf8801_dev_t *p_this,
                                  uint32_t                 subaddr,
                                  uint8_t                 *p_buf,
                                  uint32_t                 nbytes)
{
    return am_i2c_read(&p_this->i2c_dev,
                       subaddr,
                       p_buf,
                       nbytes);
}

/**
 * \brief 读取 TMF8801 状态标志位 
 *
 * \retval AM_OK    : 操作成功
 * \retval AM_ERROR : 操作失败
 */
static int8_t __tmf8801_status_read (am_sensor_tmf8801_dev_t *p_this)
{
    uint8_t sta_buf[3] = {0};
    
    /* 读状态寄存器 */
    __tmf8801_read(p_this, __TMF8801_REG_BL_CMD_STAT, sta_buf, 3);

    if (sta_buf[0] != 0x00 ||
        sta_buf[1] != 0x00 ||
        sta_buf[2] != 0xFF) 
    {
        return AM_ERROR;
    }
    return AM_OK;
}

/**
 * \brief 初始化下载 HW 
 */
static int8_t __tmf8801_download_init (am_sensor_tmf8801_dev_t *p_this)
{
    /*
     * cmd_buf[0]    : 初始化下载 HW 命令(0x14)
     * cmd_buf[1]    : 数据长度(0x01)
     * cmd_buf[3]    : 1个字节数据
     * cmd_buf[4]    : 校验字节
     */
    uint8_t  cmd_buf[] = {0x14, 0x01, 0x29, 0xC1};
    uint32_t tick = 0;
    
    __tmf8801_write(p_this, __TMF8801_REG_BL_CMD_STAT, cmd_buf, 4);
    
    while (1) 
    {
        if (__tmf8801_status_read(p_this) == AM_OK) 
        {
            break;
        }
        tick ++;
        if (tick >= 10) 
        {
#if __TMF8801_DEBUG
            printf("__tmf8801_download_init error!\r\n");
#endif
            return AM_ERROR;
        }
    }
    return AM_OK;
}

/**
 * \brief 设置写 RAM 地址
 */
static int8_t __tmf8801_set_ram_addr (am_sensor_tmf8801_dev_t *p_this,
                                      uint16_t                 addr)
{
    /*
     * cmd_buf[0]    : 写 RAM 地址命令(0x43)
     * cmd_buf[1]    : 数据长度(0x02)
     * cmd_buf[4:3]  : 2个字节数据
     * cmd_buf[5]    : 校验字节
     */
    uint8_t  cmd_buf[5] = {0};
    uint32_t tick       =  0;
    
    cmd_buf[0] = 0x43;                  
    cmd_buf[1] = 0x02;
    cmd_buf[2] = (uint8_t)addr;         /* 地址低 8 位 */
    cmd_buf[3] = (uint8_t)(addr >> 8);  /* 地址高 8 位 */
    cmd_buf[4] = (cmd_buf[0]            /* 校验字节 */ 
               +  cmd_buf[1]
               +  cmd_buf[2]
               +  cmd_buf[3])
               ^ 0xFF;
             
    __tmf8801_write(p_this, __TMF8801_REG_BL_CMD_STAT, cmd_buf, 5);
    
    while (1) 
    {
        if (__tmf8801_status_read(p_this) == AM_OK) 
        {
            break;
        }
        tick ++;
        if (tick >= 10) 
        {
#if __TMF8801_DEBUG
            printf("__tmf8801_set_ram_addr error!\r\n");
#endif
            return AM_ERROR;
        }
    }
    return AM_OK;
}

/**
 * \brief 写 RAM 
 */
static int8_t __tmf8801_write_ram (am_sensor_tmf8801_dev_t *p_this)
{   
    /*
     * cmd_buf[0]    : 命令(0x41)
     * cmd_buf[1]    : 数据长度(0x10)
     * cmd_buf[17:2] : 16个字节数据
     * cmd_buf[18]   : 校验字节
     */
    uint8_t  cmd_buf[19] = {0};  
    
    uint16_t buf_length  =  0;                  /* __g_app_buf 总字节个数 */ 
    uint16_t buf_line    =  0;                  /* __g_app_buf 行地址 */
    
    uint32_t tick        =  0;
    uint16_t i           =  0;
    uint16_t j           =  0;
    
    buf_length = sizeof(__g_app_buf) / sizeof(__g_app_buf[0]);
    buf_line   = buf_length / 16;
    
    cmd_buf[0] = 0x41;                          /* 写 RAM */
    cmd_buf[1] = 0x10;                          /* 待写数据长度:16字节 */
    
    for (i = 0; i < buf_line; i++) {
    
        /* 装载命令数据缓存区 */
        for (j = 0; j < 16; j++) {              /* 16字节 */
        
            cmd_buf[2+j] = __g_app_buf[16 * i + j]; 
        }
        
        /* 计算校验字节 */
        cmd_buf[18] = 0;                        /* 清零校验字节 */
        for (j = 0; j < 18; j++) {              /* 累加 */
        
            cmd_buf[18] += cmd_buf[j];
        }
        cmd_buf[18] ^= 0xFF;                    /* 异或 0xFF */

        /* 设置RAM地址 */
        __tmf8801_set_ram_addr(p_this, (16 * i));

        /* 写 RAM */
        __tmf8801_write(p_this, __TMF8801_REG_BL_CMD_STAT, cmd_buf, 19);

        /* 等待状态就绪 */
        am_udelay(150);

        /* 读状态寄存器 */
        while (1) 
        {
            if (__tmf8801_status_read(p_this) == AM_OK) 
            {
                break;
            }
            tick ++;
            if (tick >= 10)
            {
#if __TMF8801_DEBUG
                printf("__tmf8801_write_ram error!\r\n");
#endif
                return AM_ERROR;
            }
        } 
    } 
    return AM_OK;
}

/**
 * \brief 重映射 RAM 到地址 0 并复位
 */
static int8_t __tmf8801_ram_remap_rst (am_sensor_tmf8801_dev_t *p_this)
{
    /*
     * cmd_buf[0]    : RAM 地址重映射并复位命令(0x11)
     * cmd_buf[1]    : 数据长度(0x00)
     * cmd_buf[2]    : 校验字节
     */
    uint8_t  cmd_buf[] = {0x11, 0x00, 0xEE};       
    uint8_t  regval    =  0;
    uint32_t tick      =  0;
    
    __tmf8801_write(p_this, __TMF8801_REG_BL_CMD_STAT, cmd_buf, 3);

    /* 等待状态就绪 */
    am_udelay(150);
    
    while (1) 
    {
        /* wait CPU ready */
        __tmf8801_read(p_this, __TMF8801_REG_ENABLE, &regval, 1);
        if (regval == 0x41) 
        {
            break;
        }
        tick ++;
        if (tick >= 10) 
        {
#if __TMF8801_DEBUG
            printf("__tmf8801_ram_remap_rst error!\r\n");
#endif
            return AM_ERROR;
        }
    }
    return AM_OK; 
}

/**
 * \brief TMF8801 复位
 */
static int8_t __tmf8801_rst (am_sensor_tmf8801_dev_t *p_this) 
{
    uint8_t  regval = 0;       
    uint32_t tick   = 0;

    regval = 0x81;
    __tmf8801_write(p_this, __TMF8801_REG_ENABLE, &regval, 1);

    while (1) 
    {
        /* wait CPU ready */
        __tmf8801_read(p_this, __TMF8801_REG_ENABLE, &regval , 1);

        if (regval == 0x41) 
        {
            break;
        }
        tick ++;
        if (tick >= 10) 
        {
#if __TMF8801_DEBUG
            printf("__tmf8801_rst error!\r\n");
#endif
            return AM_ERROR;
        }
    }  
    return AM_OK;
}

/**
 * \brief TMF8801 APP设置
 */
static int8_t __tmf8801_app_set (am_sensor_tmf8801_dev_t *p_this, uint8_t app)
{
    uint8_t  regval = 0;       
    uint32_t tick   = 0;
    
    regval = app;
    __tmf8801_write(p_this, __TMF8801_REG_APPREQID, &regval, 1);

    while (1) 
    {
        /* wait app ready */
        __tmf8801_read(p_this, __TMF8801_REG_APPID, &regval , 1);

        if (regval == app) 
        {
            break;
        }
        tick ++;
        if (tick >= 10) 
        {
#if __TMF8801_DEBUG
            printf("__tmf8801_app_set error!\r\n");
#endif
            return AM_ERROR;
        }
    }  
    return AM_OK;
}


/**
 * \brief 获取 TMF8801 信息
 */
static int8_t __tmf8801_info_read (am_sensor_tmf8801_dev_t *p_this)
{  
    uint8_t  app0_rev_num[3] = {0};
    uint8_t  chip_rev_id     =  0;
    uint8_t  serial_num[4]   = {0};
    
    uint8_t  regval          =  0;    
    uint32_t tick            =  0;
    
    /* APP0 主版本号 */
    __tmf8801_read(p_this, __TMF8801_REG_APPREV_MAJ0R, &app0_rev_num[0], 1);
    
    /* 次版本号和修订版本号 */
    __tmf8801_read(p_this, __TMF8801_REG_APPREV_MINOR, &app0_rev_num[1], 2);
    
    /* 芯片修订 ID */
    __tmf8801_read(p_this, __TMF8801_REG_REVID, &chip_rev_id, 1);       
    
    /* 发送读序列号命令 */
    regval = 0x47;                                  
    __tmf8801_write(p_this, __TMF8801_REG_COMMAND, &regval, 1);

    /* 等待状态就绪 */
    am_udelay(500);

    while (1) 
    {                                     
        /* 等待序列号生成完毕 */
        __tmf8801_read(p_this, __TMF8801_REG_REG_CONTENT, &regval, 1);
        if (regval == 0x47) 
        {
            break;
        }
        tick ++;
        if (tick >= 10) {
#if __TMF8801_DEBUG
            printf("__tmf8801_info_read error!\r\n");
#endif
            return AM_ERROR;
        }
    }   
    __tmf8801_read(p_this, __TMF8801_REG_SERIAL_NUMBER_0, serial_num, 4);

#if __TMF8801_DEBUG
    /* 打印 */
    printf("Serial Number: %02x-%02x-%02x-%02x\r\n",
            serial_num[0], serial_num[1], serial_num[2], serial_num[3]);
    printf("App0 Revision: %d.%d.%d\r\n",
            app0_rev_num[0], app0_rev_num[1], app0_rev_num[2]);
    printf("Chip Revision: %d\r\n", chip_rev_id);
#endif

    return AM_OK;
}

/**
 * \brief TMF8801 中断使能
 */
static void __tmf8801_int_enable (am_sensor_tmf8801_dev_t *p_this)
{
    uint8_t regval = 0x01;
    __tmf8801_write(p_this, __TMF8801_REG_INT_ENAB, &regval, 1);
}

/**
 * \brief TMF8801 中断禁能
 */
static void __tmf8801_int_disable (am_sensor_tmf8801_dev_t *p_this)
{
    uint8_t regval = 0x00;
    __tmf8801_write(p_this, __TMF8801_REG_INT_ENAB, &regval, 1);
}

/**
 * \brief TMF8801 中断状态清除
 */
static void __tmf8801_int_status_clr (am_sensor_tmf8801_dev_t *p_this)
{
    uint8_t regval = 0x03;
    __tmf8801_write(p_this, __TMF8801_REG_INT_STATUS, &regval, 1);
}

/**
 * \brief TMF8801 初始化
 */
static int8_t __tmf8801_init (am_sensor_tmf8801_dev_t *p_this)
{   
    /* TMF8801 复位 */
    if (__tmf8801_rst(p_this) == AM_ERROR)
    {
        return AM_ERROR;
    }  

    /* TMF8801 APP设置为BootLoader */
    if (__tmf8801_app_set(p_this, __TMF8801_BOOTLOADER) == AM_ERROR)
    {
        return AM_ERROR;
    } 
    
    /* 补丁下载初始化 */    
    if (__tmf8801_download_init(p_this) == AM_ERROR) 
    {  
        return AM_ERROR;
    }
    /* 设置写 RAM 地址 */
    if (__tmf8801_set_ram_addr(p_this, 0x00) == AM_ERROR)
    {
        return AM_ERROR;
    }
    /* 写 RAM */
    if (__tmf8801_write_ram(p_this) == AM_ERROR) 
    {
        return AM_ERROR;
    }     
    /* 复位 RAM */
    if (__tmf8801_ram_remap_rst(p_this) == AM_ERROR) 
    {
        return AM_ERROR;
    }

    /* 获取 TMF8801 芯片信息 */
    if (__tmf8801_info_read(p_this) == AM_ERROR) 
    {
        return AM_ERROR;
    } 

    return AM_OK;
}

/**
 * \brief TMF8801 启动测量APP
 */
static int8_t __tmf8801_app0_start (am_sensor_tmf8801_dev_t *p_this,
                                    app0_config_t           *p_config)
{   
    /*
     * cmd_data7=03  Algorithm state and factory calibration is provided
     * cmd_data6=23  
     * cmd_data5=00  No GPIO control used
     * cmd_data4=00  No GPIO control used
     * cmd_data3=00  Object detection threshold
     * cmd_data2=64  Repetition period in ms 64 hex = 100ms
     * cmd_data1=84  Number of iterations, low byte; 1 LSB=1 k
     * cmd_data0=03  Number of iterations, high byte; Set to 900k iterations
     * command  =02  Set flag to perform target distance measurement with 8 
     *               bytes of data containing where including setting of 
     *               calibration (and algorithm state) configuration.
     */
    uint8_t cmd_buf[9] = {0x00, 0xA3, 0x00, 0x00, 0x00, 0x64, 0x84, 0x03, 0x02};    

    uint8_t  regval    =  0;
    int      ret       = AM_OK;
    
    __tmf8801_read(p_this, __TMF8801_REG_ENABLE, &regval, 1);
    if (regval != 0x41) 
    {
        /* CPU 没准备好与主机 IIC 通信 */
        return AM_ERROR;
    }
    
    /* 配置 APP0 相关参数 */
    cmd_buf[0] = p_config->calibration_state_mask;
    cmd_buf[2] = p_config->gpio_control;
    cmd_buf[3] = p_config->gpio_output_control;
    cmd_buf[5] = p_config->repetition_period_ms;
    cmd_buf[6] = p_config->iterations & 0xFF;
    cmd_buf[7] = (p_config->iterations >> 8) & 0xFF;
     
    /* 预装载工厂校准数据或算法状态数据 */    
    if (cmd_buf[0] & __TMF8801_FACTORY_CALIBRATION_PROVIDE) 
    {
        /* 写入 14 字节校准数据 */
        ret = __tmf8801_write(p_this,
                              __TMF8801_REG_FACTORY_CALIB_0,
                              __g_cali_buf,
                              14);
        if (ret != AM_OK) {
            return ret;
        }

        if (cmd_buf[0] & __TMF8801_ALGORITHM_STATE_PROVIDE) 
        {
            /* 提供了算法状态数据 */
            /* 写入 11 字节算法状态数据 */
            ret = __tmf8801_write(p_this,
                                  __TMF8801_REG_STATE_DATA_WR_0,
                                  __g_state_buf,
                                  11);
            if (ret != AM_OK) {
                return ret;
            }
        }
    } 
    else if (cmd_buf[0] & __TMF8801_ALGORITHM_STATE_PROVIDE) 
    {
        /* 提供了算法状态数据 */
        /* 写入 11 字节算法状态数据 */
        ret = __tmf8801_write(p_this,
                              __TMF8801_REG_STATE_DATA_WR_0,
                              __g_state_buf,
                              11);
        if (ret != AM_OK) {
            return ret;
        }
    }
    
    /* 配置 TOF 功能并启动 */
    ret = __tmf8801_write(p_this, __TMF8801_REG_CMD_DATA7, cmd_buf, 9);
    if (ret != AM_OK) {
        return ret;
    }

#if __TMF8801_DEBUG
    /* 回显打印 */
    printf("配置并启动APP0:\r\n"); 
    for (i = 0; i < 9; i++) 
    {             
        printf("%02x ", cmd_buf[i]);
    }
    printf("\r\n");
#endif

    return AM_OK;
}

/**
 * \brief TMF8801 测量结果获取
 */
static int8_t __tmf8801_result_get (am_sensor_tmf8801_dev_t *p_this,
                                    result_info_t           *p_res)
{
    uint8_t result_buf[0x3A - 0x20 + 1] = {0};
    uint8_t regval                      =  0;
    uint8_t i                           =  0;
    uint8_t ret                         = AM_OK;
    
    __tmf8801_read(p_this, __TMF8801_REG_STATUS, &regval, 1);
    __tmf8801_read(p_this, __TMF8801_REG_REG_CONTENT, &regval, 1);
    if (regval != 0x55) 
    {
        /* 未生成结果数据 */
        return AM_ENODATA;
    }
    
    /* 读取结果数据 */
    ret = __tmf8801_read(p_this,
                         __TMF8801_REG_RESULT_NUMBER,
                         result_buf,
                         (0x3A - 0x20 + 1));
    if (ret != AM_OK) {
        return ret;
    }
    
    p_res->result_num        = result_buf[0x20 - 0x20];
    p_res->reliability       = result_buf[0x21 - 0x20] & 0x3F;
    
    
    p_res->distance_peak     = ((uint16_t)result_buf[0x23 - 0x20] << 8) 
                             + result_buf[0x22 - 0x20];
    
    p_res->time_stamp        = ((uint32_t)result_buf[0x27 - 0x20] << 24) | 
                               ((uint32_t)result_buf[0x26 - 0x20] << 16) |
                               ((uint32_t)result_buf[0x25 - 0x20] << 8)  |
                               ((uint32_t)result_buf[0x24 - 0x20] << 0);
    
    p_res->reference_hits    = ((uint32_t)result_buf[0x36 - 0x20] << 24) | 
                               ((uint32_t)result_buf[0x35 - 0x20] << 16) |
                               ((uint32_t)result_buf[0x34 - 0x20] << 8)  |
                               ((uint32_t)result_buf[0x33 - 0x20] << 0);
                               
    p_res->object_hits       = ((uint32_t)result_buf[0x3A - 0x20] << 24) | 
                               ((uint32_t)result_buf[0x39 - 0x20] << 16) |
                               ((uint32_t)result_buf[0x38 - 0x20] << 8)  |
                               ((uint32_t)result_buf[0x37 - 0x20] << 0);

    p_res->temperature       = (int32_t)(result_buf[0x32 - 0x20]);

    /* 备份算法状态数据 */
    for (i = 0; i < 11; i++) {
        __g_state_buf[i] = result_buf[0x28 - 0x20 + i];
    }
    return AM_OK;
}

/**
 * \brief TMF8801 停止测量APP
 */
static int8_t __tmf8801_app0_stop (am_sensor_tmf8801_dev_t *p_this)
{
    uint32_t tick   = 0;   
    uint8_t  regval = 0xFF;
    
    __tmf8801_write(p_this, __TMF8801_REG_COMMAND, &regval, 1);
    
    while (1) 
    {
        /* wait CPU ready */
        __tmf8801_read(p_this, __TMF8801_REG_ENABLE, &regval, 1);
        if (regval == 0x41) 
        {
            break;
        }       
        tick ++;
        if (tick >= 5) 
        {   
            /* 重新发送停止命令 */
            __tmf8801_write(p_this, __TMF8801_REG_COMMAND, &regval, 1);
        }
        if (tick >= 10)  
        { /* 超时 */

#if __TMF8801_DEBUG
            printf("tmf8801_app0_stop error!\r\n");
#endif
            return AM_ERROR;
        }
    }    
    return AM_OK;  
}

/**
 * \brief TMF8801 工厂校准
 */
static int8_t __tmf8801_factory_calibration (am_sensor_tmf8801_dev_t *p_this)
{
    uint8_t  regval  = 0;
    uint32_t tick    = 0;

    __tmf8801_read(p_this, __TMF8801_REG_ENABLE, &regval, 1);
    if (regval != 0x41) 
    {
        /* 传感器忙 */
        return AM_EAGAIN;
    }

    /* 执行工厂校准命令 */
    regval = 0x0A;
    __tmf8801_write(p_this, __TMF8801_REG_COMMAND, &regval, 1);
    am_mdelay(1500);
    
    while (1) 
    {
        /* 等待校准数据生成完毕 */
        __tmf8801_read(p_this, __TMF8801_REG_REG_CONTENT, &regval, 1);
        if (regval == 0x0A) 
        {
            break;
        }
        tick ++;
        if (tick >= 0xFFF)
        {
#if __TMF8801_DEBUG
            printf("tmf8801_factory_calibration tmo!\r\n");
#endif
            return AM_ERROR;
        }
    }
    
    /* 读取14字节的校验数据 */
    __tmf8801_read(p_this, __TMF8801_REG_FACTORY_CALIB_0, __g_cali_buf, 14);

#if __TMF8801_DEBUG
    printf("工厂校准数据: ");
    for (i = 0; i < 14; i++) 
    {             
        printf("0x%02x, ", __g_cali_buf[i]);
    }
    printf("\r\n");
#endif

    return AM_OK;   
}

/**
 * \brief TMF8801 测量默认配置获取
 */
static void __tmf8801_app0_default_config_get (app0_config_t *p_config)
{
    /* 不提供工厂校准数据和算法状态数据 */
    p_config->calibration_state_mask = __TMF8801_NO_DATA_PROVIDE;
    
    /* GPIO0, GPIO1 均作输入(复位值) */
    p_config->gpio_control           =  __TMF8801_GPIO0_INPUT |
                                        __TMF8801_GPIO1_INPUT;
       
    /* 无信号输出 */
    p_config->gpio_output_control    = 0;
    
    /* 重复测量周期为 6ms */
    p_config->repetition_period_ms   = 6;       

    /* 迭代次数 900k */
    p_config->iterations             = 900;
}

/** \breif 中断回调函数 */
am_local void __tmf8801_alarm_callback (void *p_arg)
{
    am_sensor_tmf8801_dev_t* p_this = (am_sensor_tmf8801_dev_t*)p_arg;

    am_isr_defer_job_add(&p_this->g_myjob);   /*< \brief 添加中断延迟处理任务 */
}

/** \breif 中断延迟函数 */
am_local void __am_pfnvoid_t (void *p_arg)
{
    am_sensor_tmf8801_dev_t* p_this = (am_sensor_tmf8801_dev_t*)p_arg;

    result_info_t result;

    /* 清中断标志位 */
    __tmf8801_int_status_clr(p_this);
    
    /* 获取数据 */
    __tmf8801_result_get(p_this, &result);

    /* 获取距离 */
    p_this->data[0].val = result.distance_peak;
    p_this->data[0].unit = AM_SENSOR_UNIT_MILLI;

    /* 获取温度 */
    p_this->data[1].val = result.temperature;
    p_this->data[1].unit = AM_SENSOR_UNIT_BASE;

    if (p_this->pfn_trigger_cb[0] &&
            (p_this->flags[0] & AM_SENSOR_TRIGGER_DATA_READY)) {
        p_this->pfn_trigger_cb[0](p_this->p_arg[0],
                                  AM_SENSOR_TRIGGER_DATA_READY);
    }

    if (p_this->pfn_trigger_cb[1] &&
            (p_this->flags[1] & AM_SENSOR_TRIGGER_DATA_READY)) {
        p_this->pfn_trigger_cb[1](p_this->p_arg[1],
                                  AM_SENSOR_TRIGGER_DATA_READY);
    }
}

/** \brief 获取该传感器某一通道的类型 */
am_local am_err_t __pfn_type_get (void *p_drv, int id)
{
    if (p_drv == NULL) {
        return -AM_EINVAL;
    }

    if (id == AM_TMF8801_CHAN_1) {
        return AM_SENSOR_TYPE_DISTANCE;
    } else if (id == AM_TMF8801_CHAN_2) {
        return AM_SENSOR_TYPE_TEMPERATURE;
    }  else {
        return -AM_ENODEV;
    }
}

/** \brief 获取传感器通道采样数据 */
am_local am_err_t __pfn_data_get (void            *p_drv,
                                  const int       *p_ids,
                                  int              num,
                                  am_sensor_val_t *p_buf)
{
    am_sensor_tmf8801_dev_t* p_this = (am_sensor_tmf8801_dev_t*)p_drv;

    am_err_t ret = AM_OK;
    result_info_t result;

    int cur_id = 0;
    int i = 0;
    int times = 0;

    if (p_drv == NULL) {
        return -AM_EINVAL;
    }

    if (AM_BIT_GET(p_this->trigger, 7) != 1) {
        return -AM_EPERM;
    }

    for (i = 0; i < num; i++) {
        p_buf[i].unit = AM_SENSOR_UNIT_INVALID;
    }

    /* 若为1，则可能在数据准备就绪触发回调函数中使用 */
    if (num == 1) {
        cur_id = p_ids[0];
        /* 若打开数据准备就绪触发方式，则直接赋值 */
        if ((AM_BIT_GET(p_this->trigger, 2)) &&
                (p_this->flags[0] & AM_SENSOR_TRIGGER_DATA_READY)) {
            p_buf[0].val = p_this->data[cur_id].val;
            p_buf[0].unit= p_this->data[cur_id].unit;
            return AM_OK;
        }
    }

    /* 获取测量数据 */
    do {
        ret = __tmf8801_result_get(p_this, &result);
        times++;
    } while (ret != AM_OK && times < 0xFF);

    /* 读取结果超时 */
    if (ret != AM_OK) {
        return ret;
    }

    for (i = 0; i < num; i++) {

        cur_id = p_ids[i];

        if (cur_id == 0) {

            p_buf[i].val  = result.distance_peak; /*< \brief 距离 */
            p_buf[i].unit = AM_SENSOR_UNIT_MILLI; /*< \brief 单位默认为-2:10^(-2)*/

        } else if (cur_id == 1) {

            p_buf[i].val  = result.temperature;   /*< \brief 温度 */
            p_buf[i].unit = AM_SENSOR_UNIT_BASE;  /*< \brief 单位默认为1:10^(0)*/

        }  else {
            return -AM_ENODEV;  /*< \brief 若此次通道不属于该传感器，直接返回 */
        }
    }

    return ret;
}

/** \brief 使能传感器通道 */
am_local am_err_t __pfn_enable (void            *p_drv,
                                const int       *p_ids,
                                int              num,
                                am_sensor_val_t *p_result)
{
    am_sensor_tmf8801_dev_t* p_this = (am_sensor_tmf8801_dev_t*)p_drv;

    int i = 0;
    int cur_id = 0;
    app0_config_t config;

    am_err_t ret = -AM_ENODEV;
    am_err_t curent_ret = AM_OK;

    if (p_drv == NULL) {
        return -AM_EINVAL;
    }

    for (i = 0; i < num; i++) {

        cur_id = p_ids[i];

        if (cur_id == 0 || cur_id == 1) {
            if (p_result != NULL) {
                p_result[i].val = AM_OK;
            }
            ret = AM_OK;
        } else {
            if (p_result != NULL) {
                p_result[i].val = -AM_ENODEV;
            }
            curent_ret = -AM_ENODEV;
        }
    }

    if (ret != AM_OK) {     /*< \breif 如果本次没有该传感器的通道传入，则退出 */
        return curent_ret;
    }

    /* 配置APP参数 */
    __tmf8801_app0_default_config_get(&config);
    config.calibration_state_mask = __TMF8801_FACTORY_CALIBRATION_PROVIDE;
    config.repetition_period_ms = 6;
    config.iterations           = 900;
    
    /* 启动APP0 */
    ret = __tmf8801_app0_start(p_this, &config);

    if (ret != AM_OK) {
        return ret;
    }
    
    if (ret == AM_OK) {
        AM_BIT_SET(p_this->trigger, 7);
        AM_BIT_SET(p_this->trigger, 6);
        AM_BIT_SET(p_this->trigger, 5);
    }

    return curent_ret;
}

/** \brief 禁能传感器通道 */
am_local am_err_t __pfn_disable (void            *p_drv,
                                 const int       *p_ids,
                                 int              num,
                                 am_sensor_val_t *p_result)
{
    am_sensor_tmf8801_dev_t* p_this = (am_sensor_tmf8801_dev_t*)p_drv;

    int i = 0;
    int cur_id = 0;

    am_err_t ret = AM_OK;
    am_err_t cur_ret = AM_OK;

    if (p_drv == NULL) {
        return -AM_EINVAL;
    }

    for (i = 0; i < num; i++) {

        cur_id = p_ids[i];

        if (cur_id == 0) {

            AM_BIT_CLR(p_this->trigger, 6);
            ret = AM_OK;

        } else if (cur_id == 1) {

            AM_BIT_CLR(p_this->trigger, 5);
            ret = AM_OK;

        } else {
            ret = -AM_ENODEV;
        }

        if (p_result != NULL) {
            p_result[i].val = ret;
        }
    }

    if ((AM_BIT_GET(p_this->trigger, 6) == 0)
            && (AM_BIT_GET(p_this->trigger, 5) == 0)) {

        ret = __tmf8801_app0_stop(p_this);
        if (ret != AM_OK){
            cur_ret = ret;
        }
                
        if (cur_ret == AM_OK) {
            AM_BIT_CLR(p_this->trigger, 7);
        }
    }

    return cur_ret;
}

/** \brief 配置传感器通道属性 */
am_local am_err_t __pfn_attr_set (void                  *p_drv,
                                  int                    id,
                                  int                    attr,
                                  const am_sensor_val_t *p_val)
{
    am_err_t ret = AM_OK;
    
    if (p_drv == NULL) {
        return -AM_EINVAL;
    }

    switch (attr) {

    default:
        ret = -AM_ENOTSUP;
        break;
    }

    return ret;
}

/** \brief 获取传感器通道属性 */
am_local am_err_t __pfn_attr_get (void            *p_drv,
                                  int              id,
                                  int              attr,
                                  am_sensor_val_t *p_val)
{
    am_err_t ret = AM_OK;

    if (id != AM_TMF8801_CHAN_1 && id != AM_TMF8801_CHAN_2) {
        return -AM_ENODEV;
    }

    if (p_drv == NULL) {
        return -AM_EINVAL;
    }

    switch (attr) {

    default:
        ret = -AM_ENOTSUP;
        break;

    }

    return ret;
}

/** \brief 设置触发，一个通道仅能设置一个触发回调函数 */
am_local am_err_t __pfn_trigger_cfg (void                   *p_drv,
                                     int                     id,
                                     uint32_t                flags,
                                     am_sensor_trigger_cb_t  pfn_cb,
                                     void                   *p_arg)
{
    am_sensor_tmf8801_dev_t* p_this = (am_sensor_tmf8801_dev_t*)p_drv;

    if (id != 0 && id != 1) {
        return -AM_ENODEV;
    }

    if (p_drv == NULL) {
        return -AM_EINVAL;
    }

    switch (flags) {
    case AM_SENSOR_TRIGGER_DATA_READY:
        break;
    default:
        return -AM_ENOTSUP;
    }

    p_this->pfn_trigger_cb[id] = pfn_cb;
    p_this->p_arg[id]          = p_arg;
    p_this->flags[id]          = flags;

    return AM_OK;
}

/** \brief 打开触发 */
am_local am_err_t __pfn_trigger_on (void *p_drv, int id)
{
    am_sensor_tmf8801_dev_t* p_this = (am_sensor_tmf8801_dev_t*)p_drv;

    am_err_t ret = AM_OK;
    am_err_t cur_ret = AM_OK;

    if (id != 0 && id != 1) {
        return -AM_ENODEV;
    }

    if (p_drv == NULL) {
        return -AM_EINVAL;
    }

    if (p_this->trigger & 0x4) {
        return AM_OK;
    }

    if (p_this->dev_info->trigger_pin != -1) {
        ret = am_gpio_trigger_on(p_this->dev_info->trigger_pin);
        if (ret != AM_OK) {
            cur_ret = ret;
        }
    }

    /* 清中断标志位 */
    __tmf8801_int_status_clr(p_this);

    /* 使能中断 */
    __tmf8801_int_enable(p_this);

    if (cur_ret == AM_OK && id == 0) {
        AM_BIT_SET(p_this->trigger, 0);
        AM_BIT_SET(p_this->trigger, 2);
    }
    if (cur_ret == AM_OK && id == 1) {
        AM_BIT_SET(p_this->trigger, 1);
        AM_BIT_SET(p_this->trigger, 2);
    }

    return cur_ret;
}

/** \brief 关闭触发 */
am_local am_err_t __pfn_trigger_off (void *p_drv, int id)
{
    am_sensor_tmf8801_dev_t* p_this = (am_sensor_tmf8801_dev_t*)p_drv;

    am_err_t ret = AM_OK;
    am_err_t cur_ret = AM_OK;

    if (id != 0 && id != 1) {
        return -AM_ENODEV;
    }

    if (p_drv == NULL) {
        return -AM_EINVAL;
    }

    p_this->pfn_trigger_cb[id] = NULL;
    p_this->p_arg[id]          = NULL;
    p_this->flags[id]          = 0;

    AM_BIT_CLR(p_this->trigger, id);

    if ((p_this->trigger & 0x3) == 0) {

        if ((p_this->dev_info->trigger_pin != -1) && (cur_ret == AM_OK)) {
            ret = am_gpio_trigger_off(p_this->dev_info->trigger_pin);
            if (ret != AM_OK) {
                cur_ret = ret;
            }
        }

        if (cur_ret == AM_OK) {

            /* 禁能中断 */
            __tmf8801_int_disable(p_this);
            AM_BIT_CLR(p_this->trigger, 2);
        }
    }

    return cur_ret;
}

/*******************************************************************************
  Public functions
*******************************************************************************/
/**
 * \brief 传感器 TMF8801 初始化
 */
am_sensor_handle_t am_sensor_tmf8801_init (
        am_sensor_tmf8801_dev_t           *p_dev,
        const am_sensor_tmf8801_devinfo_t *p_devinfo,
        am_i2c_handle_t                   handle)
{
    am_err_t ret = AM_OK;
    am_err_t cur_ret = AM_OK;

    uint8_t tmf8801_id = 0;
    uint8_t reg = 0;

    if (p_dev == NULL || p_devinfo == NULL) {
        return NULL;
    }

    am_i2c_mkdev(&p_dev->i2c_dev,
                 handle,
                 p_devinfo->i2c_addr,
                 AM_I2C_ADDR_7BIT | AM_I2C_SUBADDR_1BYTE);

    p_dev->tmf8801_dev.p_drv   = p_dev;
    p_dev->tmf8801_dev.p_funcs = &__g_sensor_tmf8801_funcs;
    p_dev->dev_info            = p_devinfo;
    p_dev->pfn_trigger_cb[0]   = NULL;
    p_dev->p_arg[0]            = NULL;
    p_dev->flags[0]            = 0;
    p_dev->trigger             = 0;
    p_dev->data[0].val         = 0;
    p_dev->data[0].unit        = AM_SENSOR_UNIT_INVALID;

    if (p_devinfo->trigger_pin != -1) {
        
        am_gpio_pin_cfg(p_devinfo->trigger_pin, AM_GPIO_INPUT | AM_GPIO_PULLUP);
        am_gpio_trigger_connect(p_devinfo->trigger_pin,
                                __tmf8801_alarm_callback,
                                (void*)p_dev);
        am_gpio_trigger_cfg(p_devinfo->trigger_pin, AM_GPIO_TRIGGER_FALL);
    }

    am_isr_defer_job_init(&p_dev->g_myjob, __am_pfnvoid_t, p_dev, 1);

    /* TOF硬件复位 */
    am_gpio_pin_cfg(p_devinfo->enable_pin, AM_GPIO_OUTPUT_INIT_LOW);
    am_mdelay(50);

    /* TOF使能 */
    am_gpio_set(p_devinfo->enable_pin, AM_GPIO_LEVEL_HIGH);
    am_mdelay(50);

    /* TOF软件复位 */
    reg = __TMF8801_SW_RST;
    __tmf8801_write(p_dev, __TMF8801_REG_ENABLE, &reg, 1);
    am_mdelay(10);
    
    /* 等待复位完成 */
    do {
        __tmf8801_read(p_dev, __TMF8801_REG_ENABLE, &reg, 1);

    } while (reg & __TMF8801_SW_RST);
    
    /* 读取ID */
    cur_ret = __tmf8801_read(p_dev, __TMF8801_REG_ID, &tmf8801_id, 1);

    if (cur_ret != AM_OK || (tmf8801_id & __TMF8801_ID) != __TMF8801_ID) {
        am_kprintf("\r\nSensor TMF8801 Init is ERROR! \r\n");
        return NULL;
    }

    /* 初始化，写入APP并复位 */
    ret = __tmf8801_init(p_dev);
    if (ret != AM_OK) {
        cur_ret = ret;
    }

    /* 执行工厂校准 */
    ret = __tmf8801_factory_calibration(p_dev);
    if (ret != AM_OK) {
        cur_ret = ret;
    }

    if (cur_ret != AM_OK) {
        return NULL;
    }

    return &(p_dev->tmf8801_dev);
}

/**
 * \brief 传感器 TMF8801 去初始化
 */
am_err_t am_sensor_tmf8801_deinit (am_sensor_handle_t handle)
{
    am_sensor_tmf8801_dev_t *p_dev = handle->p_drv;

    if (handle == NULL) {
        return -AM_EINVAL;
    }

    p_dev->tmf8801_dev.p_drv   = NULL;
    p_dev->tmf8801_dev.p_funcs = NULL;
    p_dev->dev_info           = NULL;

    return AM_OK;
}

/* end of file */
